/* USER CODE BEGIN Header */
/**
  ******************************************************************************
  * @file           : main.c
  * @brief          : Main program body
  ******************************************************************************
  */
/* USER CODE END Header */
/* Includes ------------------------------------------------------------------*/
#include "main.h"

/* Private includes ----------------------------------------------------------*/
/* USER CODE BEGIN Includes */
#include <stdio.h>
/* USER CODE END Includes */

/* Private typedef -----------------------------------------------------------*/
/* USER CODE BEGIN PTD */

/* USER CODE END PTD */

/* Private define ------------------------------------------------------------*/
/* USER CODE BEGIN PD */

/* USER CODE END PD */

/* Private macro -------------------------------------------------------------*/
/* USER CODE BEGIN PM */

/* USER CODE END PM */

/* Private variables ---------------------------------------------------------*/
I2C_HandleTypeDef hi2c1;

TIM_HandleTypeDef htim3;

UART_HandleTypeDef huart1;
UART_HandleTypeDef huart2;

/* USER CODE BEGIN PV */
uint8_t uart1_rx_byte;
char esp32_rx_buffer[64];
uint8_t esp32_rx_index = 0;
uint32_t uart_rx_count = 0;

int target_face_x = 0;
int target_face_y = 0;
int face_detected = 0;
uint32_t last_face_time = 0;

uint16_t sgp30_co2 = 400;
uint16_t sgp30_tvoc = 0;
/* USER CODE END PV */

/* Private function prototypes -----------------------------------------------*/
void SystemClock_Config(void);
static void MX_GPIO_Init(void);
static void MX_USART2_UART_Init(void);
static void MX_I2C1_Init(void);
static void MX_TIM3_Init(void);
static void MX_USART1_UART_Init(void);
/* USER CODE BEGIN PFP */

/* USER CODE END PFP */

/* Private user code ---------------------------------------------------------*/
/* USER CODE BEGIN 0 */
typedef enum {
    EMOTION_HAPPY,
    EMOTION_ANGRY,
    EMOTION_SEARCHING,
    EMOTION_DIZZY
} RobotEmotion;

RobotEmotion current_emotion = EMOTION_HAPPY;
uint32_t last_bop_time = 0;

void DWT_Delay_us(uint32_t us) {
    uint32_t startTick = DWT->CYCCNT;
    uint32_t delayTicks = us * (SystemCoreClock / 1000000);
    while (DWT->CYCCNT - startTick < delayTicks);
}

int HCSR04_Read(void) {
    HAL_GPIO_WritePin(GPIOA, GPIO_PIN_8, GPIO_PIN_RESET);
    DWT_Delay_us(2);
    HAL_GPIO_WritePin(GPIOA, GPIO_PIN_8, GPIO_PIN_SET);
    DWT_Delay_us(10);
    HAL_GPIO_WritePin(GPIOA, GPIO_PIN_8, GPIO_PIN_RESET);
    
    uint32_t timeout = DWT->CYCCNT;
    uint32_t timeoutTicks = 20000 * (SystemCoreClock / 1000000);
    
    while (HAL_GPIO_ReadPin(GPIOC, GPIO_PIN_7) == GPIO_PIN_RESET) {
        if (DWT->CYCCNT - timeout > timeoutTicks) return -1;
    }
    
    uint32_t start_time = DWT->CYCCNT;
    while (HAL_GPIO_ReadPin(GPIOC, GPIO_PIN_7) == GPIO_PIN_SET) {
        if (DWT->CYCCNT - start_time > timeoutTicks) return -1;
    }
    
    uint32_t elapsed_us = (DWT->CYCCNT - start_time) / (SystemCoreClock / 1000000);
    return elapsed_us / 58;
}

void SGP30_Init(void) {
    uint8_t cmd[2] = {0x20, 0x03};
    HAL_I2C_Master_Transmit(&hi2c1, 0x58 << 1, cmd, 2, 100);
}

void SGP30_Measure(uint16_t *co2, uint16_t *tvoc) {
    uint8_t cmd[2] = {0x20, 0x08};
    HAL_I2C_Master_Transmit(&hi2c1, 0x58 << 1, cmd, 2, 100);
    HAL_Delay(12);
    uint8_t data[6];
    if (HAL_I2C_Master_Receive(&hi2c1, 0x58 << 1, data, 6, 100) == HAL_OK) {
        *co2 = (data[0] << 8) | data[1];
        *tvoc = (data[3] << 8) | data[4];
    }
}

void set_motors(int speed_left, int speed_right) {
    if (speed_left > 0) {
        HAL_GPIO_WritePin(GPIOB, GPIO_PIN_13, GPIO_PIN_SET);
        HAL_GPIO_WritePin(GPIOB, GPIO_PIN_14, GPIO_PIN_RESET);
    } else if (speed_left < 0) {
        HAL_GPIO_WritePin(GPIOB, GPIO_PIN_13, GPIO_PIN_RESET);
        HAL_GPIO_WritePin(GPIOB, GPIO_PIN_14, GPIO_PIN_SET);
        speed_left = -speed_left;
    } else {
        HAL_GPIO_WritePin(GPIOB, GPIO_PIN_13, GPIO_PIN_RESET);
        HAL_GPIO_WritePin(GPIOB, GPIO_PIN_14, GPIO_PIN_RESET);
    }
    
    if (speed_right > 0) {
        HAL_GPIO_WritePin(GPIOB, GPIO_PIN_15, GPIO_PIN_SET);
        HAL_GPIO_WritePin(GPIOB, GPIO_PIN_1, GPIO_PIN_RESET);
    } else if (speed_right < 0) {
        HAL_GPIO_WritePin(GPIOB, GPIO_PIN_15, GPIO_PIN_RESET);
        HAL_GPIO_WritePin(GPIOB, GPIO_PIN_1, GPIO_PIN_SET);
        speed_right = -speed_right;
    } else {
        HAL_GPIO_WritePin(GPIOB, GPIO_PIN_15, GPIO_PIN_RESET);
        HAL_GPIO_WritePin(GPIOB, GPIO_PIN_1, GPIO_PIN_RESET);
    }

    if (speed_left > 999) speed_left = 999;
    if (speed_right > 999) speed_right = 999;
    __HAL_TIM_SET_COMPARE(&htim3, TIM_CHANNEL_1, speed_left);
    __HAL_TIM_SET_COMPARE(&htim3, TIM_CHANNEL_2, speed_right);
}

void track_face() {
    if (face_detected) {
        int error = target_face_x - 160;
        int base_speed = 300; 
        int turn_speed = error * 3; 
        int left = base_speed + turn_speed;
        int right = base_speed - turn_speed;
        set_motors(left, right);
    } else {
        set_motors(0, 0);
    }
}

#define OLED_ADDR        (0x3C << 1)

void OLED_WriteCommand(uint8_t cmd) {
    uint8_t buffer[2];
    buffer[0] = 0x00;
    buffer[1] = cmd;
    HAL_I2C_Master_Transmit(&hi2c1, OLED_ADDR, buffer, 2, 10);
}

void OLED_Init(void) {
    HAL_Delay(200);
    OLED_WriteCommand(0xAE);
    OLED_WriteCommand(0xD5); OLED_WriteCommand(0x80);
    OLED_WriteCommand(0xA8); OLED_WriteCommand(0x3F);
    OLED_WriteCommand(0xD3); OLED_WriteCommand(0x00);
    OLED_WriteCommand(0x40);
    OLED_WriteCommand(0x8D); OLED_WriteCommand(0x14);
    OLED_WriteCommand(0x20); OLED_WriteCommand(0x00);
    OLED_WriteCommand(0xA1);
    OLED_WriteCommand(0xC8);
    OLED_WriteCommand(0xDA); OLED_WriteCommand(0x12);
    OLED_WriteCommand(0x81); OLED_WriteCommand(0x7F);
    OLED_WriteCommand(0xD9); OLED_WriteCommand(0x22);
    OLED_WriteCommand(0xDB); OLED_WriteCommand(0x20);
    OLED_WriteCommand(0xA4); OLED_WriteCommand(0xA6);
    OLED_WriteCommand(0xAF);
    HAL_Delay(10);
}

void OLED_Clear(void) {
    OLED_WriteCommand(0x21); OLED_WriteCommand(0); OLED_WriteCommand(127);
    OLED_WriteCommand(0x22); OLED_WriteCommand(0); OLED_WriteCommand(7);
    static uint8_t clear_buf[129];
    clear_buf[0] = 0x40;
    for(int i = 1; i <= 128; i++) clear_buf[i] = 0x00;
    for(int page = 0; page < 8; page++) {
        HAL_I2C_Master_Transmit(&hi2c1, OLED_ADDR, clear_buf, 129, 50);
    }
}

const uint8_t BasicFont[38][5] = {
    {0x3E, 0x51, 0x49, 0x45, 0x3E}, // 0
    {0x00, 0x42, 0x7F, 0x40, 0x00}, // 1
    {0x42, 0x61, 0x51, 0x49, 0x46}, // 2
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    {0x00, 0x24, 0x24, 0x24, 0x00}  // :
};

void OLED_PrintText(uint8_t page, uint8_t col, char* str) {
    OLED_WriteCommand(0x21); OLED_WriteCommand(col); OLED_WriteCommand(127);
    OLED_WriteCommand(0x22); OLED_WriteCommand(page); OLED_WriteCommand(7);
    static uint8_t tx_buf[6];
    tx_buf[0] = 0x40;
    while(*str) {
        uint8_t idx = 36;
        char c = *str;
        if (c >= '0' && c <= '9') idx = c - '0';
        else if (c >= 'A' && c <= 'Z') idx = (c - 'A') + 10;
        else if (c >= 'a' && c <= 'z') idx = (c - 'a') + 10;
        else if (c == ':') idx = 37;
        for(int i = 0; i < 5; i++) tx_buf[i + 1] = BasicFont[idx][i];
        HAL_I2C_Master_Transmit(&hi2c1, OLED_ADDR, tx_buf, 6, 10);
        str++;
    }
}

void OLED_DrawBitmap(const uint8_t* bitmap) {
    OLED_WriteCommand(0x21); OLED_WriteCommand(0); OLED_WriteCommand(127);
    OLED_WriteCommand(0x22); OLED_WriteCommand(0); OLED_WriteCommand(7);
    static uint8_t data_buffer[1025];
    data_buffer[0] = 0x40;
    for (int i = 0; i < 1024; i++) {
        data_buffer[i + 1] = bitmap[i];
    }
    HAL_I2C_Master_Transmit(&hi2c1, OLED_ADDR, data_buffer, 1025, 200);
}


// Your updated text canvas mathematically padded to a solid 64 rows and converted to vertical page bytes
const uint8_t OLED_TrueDogBitmap[1024] = {
	0x00, 0x00, 0x00, 0x00, 0x00, 0x00, 0x00, 0x00, 0x00, 0x00, 0x00, 0x00, 0x00, 0x00, 0x00, 0x00,
	0x00, 0x00, 0x00, 0x00, 0x00, 0x00, 0x00, 0x00, 0x00, 0x00, 0x00, 0x00, 0x00, 0x00, 0x00, 0x00,
	0x00, 0x00, 0x00, 0x00, 0x00, 0x00, 0x00, 0x00, 0x00, 0x00, 0x00, 0x00, 0x00, 0x00, 0x00, 0x00,
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	0x00, 0x00, 0x00, 0x00, 0x00, 0x00, 0x00, 0x00, 0x00, 0x00, 0x00, 0x00, 0x00, 0x00, 0x00, 0x00,
};

const uint8_t OLED_AngryBitmap[1024] = {
	0x00, 0x00, 0x00, 0x00, 0x00, 0x00, 0x00, 0x00, 0x00, 0x00, 0x00, 0x00, 0x00, 0x00, 0x00, 0x00, 
	0x00, 0x00, 0x00, 0x00, 0x00, 0x00, 0x00, 0x00, 0x00, 0x00, 0x00, 0x00, 0x00, 0x00, 0x00, 0x00, 
	0x00, 0x00, 0x00, 0x00, 0x00, 0x00, 0x00, 0x00, 0x00, 0x00, 0x00, 0x00, 0x00, 0x00, 0x00, 0x00, 
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	0x00, 0x00, 0x00, 0x00, 0x00, 0x00, 0x00, 0x00, 0x00, 0x00, 0x00, 0x00, 0x00, 0x00, 0x00, 0x00
};
const uint8_t OLED_SmileBitmap[1024] = {
	0x00, 0x00, 0x00, 0x00, 0x00, 0x00, 0x00, 0x00, 0x00, 0x00, 0x00, 0x00, 0x00, 0x00, 0x00, 0x00, 
	0x00, 0x00, 0x00, 0x00, 0x00, 0x00, 0x00, 0x00, 0x00, 0x00, 0x00, 0x00, 0x00, 0x00, 0x00, 0x00, 
	0x00, 0x00, 0x00, 0x00, 0x00, 0x00, 0x00, 0x00, 0x00, 0x00, 0x00, 0x00, 0x00, 0x00, 0x00, 0x00, 
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	0x00, 0x00, 0x00, 0x00, 0x00, 0x00, 0x00, 0x00, 0x00, 0x00, 0x00, 0x00, 0x00, 0x00, 0x00, 0x00
};
const uint8_t OLED_LookLeftBitmap[1024] = {
	0x00, 0x00, 0x00, 0x00, 0x00, 0x00, 0x00, 0x00, 0x00, 0x00, 0x00, 0x00, 0x00, 0x00, 0x00, 0x00, 
	0x00, 0x00, 0x00, 0x00, 0x00, 0x00, 0x00, 0x00, 0x00, 0x00, 0x00, 0x00, 0x00, 0x00, 0x00, 0x00, 
	0x00, 0x00, 0x00, 0x00, 0x00, 0x00, 0x00, 0x00, 0x00, 0x00, 0x00, 0x00, 0x00, 0x00, 0x00, 0x00, 
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	0x00, 0x00, 0x00, 0x00, 0x00, 0x00, 0x00, 0x00, 0x00, 0x00, 0x00, 0x00, 0x00, 0x00, 0x00, 0x00
};
const uint8_t OLED_LookCenterBitmap[1024] = {
	0x00, 0x00, 0x00, 0x00, 0x00, 0x00, 0x00, 0x00, 0x00, 0x00, 0x00, 0x00, 0x00, 0x00, 0x00, 0x00, 
	0x00, 0x00, 0x00, 0x00, 0x00, 0x00, 0x00, 0x00, 0x00, 0x00, 0x00, 0x00, 0x00, 0x00, 0x00, 0x00, 
	0x00, 0x00, 0x00, 0x00, 0x00, 0x00, 0x00, 0x00, 0x00, 0x00, 0x00, 0x00, 0x00, 0x00, 0x00, 0x00, 
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	0x00, 0x00, 0x00, 0x00, 0x00, 0x00, 0x00, 0x00, 0x00, 0x00, 0x00, 0x00, 0x00, 0x00, 0x00, 0x00
};
const uint8_t OLED_LookRightBitmap[1024] = {
	0x00, 0x00, 0x00, 0x00, 0x00, 0x00, 0x00, 0x00, 0x00, 0x00, 0x00, 0x00, 0x00, 0x00, 0x00, 0x00, 
	0x00, 0x00, 0x00, 0x00, 0x00, 0x00, 0x00, 0x00, 0x00, 0x00, 0x00, 0x00, 0x00, 0x00, 0x00, 0x00, 
	0x00, 0x00, 0x00, 0x00, 0x00, 0x00, 0x00, 0x00, 0x00, 0x00, 0x00, 0x00, 0x00, 0x00, 0x00, 0x00, 
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	0x00, 0x00, 0x00, 0x00, 0x00, 0x00, 0x00, 0x00, 0x00, 0x00, 0x00, 0x00, 0x00, 0x00, 0x00, 0x00
};

const uint8_t OLED_DizzyBitmap[1024] = {
	0x00, 0x00, 0x00, 0x00, 0x00, 0x00, 0x00, 0x00, 0x00, 0x00, 0x00, 0x00, 0x00, 0x00, 0x00, 0x00, 
	0x00, 0x00, 0x00, 0x00, 0x00, 0x00, 0x00, 0x00, 0x00, 0x00, 0x00, 0x00, 0x00, 0x00, 0x00, 0x00, 
	0x00, 0x00, 0x00, 0x00, 0x00, 0x00, 0x00, 0x00, 0x00, 0x00, 0x00, 0x00, 0x00, 0x00, 0x00, 0x00, 
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	0x00, 0x00, 0x00, 0x00, 0x00, 0x00, 0x00, 0x00, 0x00, 0x00, 0x00, 0x00, 0x00, 0x00, 0x00, 0x00
};
/* USER CODE END 0 */

/**
  * @brief  The application entry point.
  * @retval int
  */
int main(void)
{
  /* USER CODE BEGIN 1 */
    int pin_state = 1;
  /* USER CODE END 1 */

  /* MCU Configuration--------------------------------------------------------*/

  /* Reset of all peripherals, Initializes the Flash interface and the Systick. */
  HAL_Init();

  /* USER CODE BEGIN Init */

  /* USER CODE END Init */

  /* Configure the system clock */
  SystemClock_Config();

  /* USER CODE BEGIN SysInit */

  /* USER CODE END SysInit */

  /* Initialize all configured peripherals */
  MX_GPIO_Init();
  MX_USART2_UART_Init();
  MX_I2C1_Init();
  MX_TIM3_Init();
  MX_USART1_UART_Init();
  /* USER CODE BEGIN 2 */
    OLED_Init();
    OLED_Clear();
    
    // Start ESP32 UART Listener
    HAL_UART_Receive_IT(&huart1, &uart1_rx_byte, 1);

    // Start Motor PWM
    HAL_TIM_PWM_Start(&htim3, TIM_CHANNEL_1);
    HAL_TIM_PWM_Start(&htim3, TIM_CHANNEL_2);
    
    // Enable DWT Cycle Counter for HC-SR04 microsecond delays
    CoreDebug->DEMCR |= CoreDebug_DEMCR_TRCENA_Msk;
    DWT->CYCCNT = 0;
    DWT->CTRL |= DWT_CTRL_CYCCNTENA_Msk;

    // Wake up the ESP32 by pulling PC8 (connected to ESP32 Pin 14) HIGH
    HAL_GPIO_WritePin(GPIOC, GPIO_PIN_8, GPIO_PIN_SET);
    
    // Initialize SGP30
    SGP30_Init();

    uint8_t dev_id = 0;
    HAL_I2C_Mem_Read(&hi2c1, 0xA6, 0x00, I2C_MEMADD_SIZE_8BIT, &dev_id, 1, 100);

    uint8_t raw_data[6];
    int16_t x_accel, y_accel, z_accel;
    int16_t x_offset = 0, y_offset = 0, z_offset = 0;

    #define FILTER_DEPTH  8
    int16_t x_history[FILTER_DEPTH] = {0};
    int16_t y_history[FILTER_DEPTH] = {0};
    int16_t z_history[FILTER_DEPTH] = {0};
    uint8_t filter_idx = 0;

    if (dev_id == 0xE5) {
        printf("ADXL345 Logged On Successfully!\r\n");
        uint8_t power_ctl_data = 0x08;
        HAL_I2C_Mem_Write(&hi2c1, 0xA6, 0x2D, I2C_MEMADD_SIZE_8BIT, &power_ctl_data, 1, 100);
        HAL_Delay(100);

        HAL_I2C_Mem_Read(&hi2c1, 0xA6, 0x32, I2C_MEMADD_SIZE_8BIT, raw_data, 6, 100);
        x_offset = (int16_t)((raw_data[1] << 8) | raw_data[0]);
        y_offset = (int16_t)((raw_data[3] << 8) | raw_data[2]);
        z_offset = (int16_t)((raw_data[5] << 8) | raw_data[4]);

        printf("Calibrated! Offsets locked -> X:%d Y:%d Z:%d\r\n", x_offset, y_offset, z_offset);
        OLED_PrintText(0, 0, "CALIBRATED: OK ");
        HAL_Delay(1000);
        OLED_Clear();
    } else {
        printf("ADXL345 Handshake failed. Read ID: 0x%02X\r\n", dev_id);
        OLED_PrintText(0, 0, "SENSOR ERROR!");
    }
  /* USER CODE END 2 */

  /* Infinite loop */
  /* USER CODE BEGIN WHILE */
    static uint32_t last_toggle_time = 0;
        static uint32_t last_sgp_time = 0;
        static uint8_t display_mode = 0;      // 0 = Telemetry, 1 = Dog Canvas
        static uint8_t last_pin_state = 1;
        static uint8_t dynamic_refresh_needed = 1; // Tracks if static screens need a redraw pass
        static RobotEmotion last_rendered_emotion = EMOTION_HAPPY;

        while (1)
        {
            uint32_t current_time = HAL_GetTick();
            
            // 1. Read the Bumper (HC-SR04)
            int distance = HCSR04_Read();

            // 2. Evaluate Emotion State Machine
            if (current_time - last_bop_time < 3000) {
                current_emotion = EMOTION_DIZZY;
                set_motors(0, 0); 
            } else if (distance > 0 && distance < 15) {
                current_emotion = EMOTION_ANGRY;
                set_motors(0, 0); 
            } else if (current_time - last_face_time > 10000) {
                current_emotion = EMOTION_SEARCHING;
                set_motors(0, 0); 
            } else {
                current_emotion = EMOTION_HAPPY;
                track_face(); 
            }

            // 3. Trigger Screen Refresh on Emotion Change
            if (display_mode == 1 && last_rendered_emotion != current_emotion) {
                last_rendered_emotion = current_emotion;
                dynamic_refresh_needed = 1;
            }

            // Read Air Quality every 1 second
            if (current_time - last_sgp_time >= 1000) {
                SGP30_Measure(&sgp30_co2, &sgp30_tvoc);
                last_sgp_time = current_time;
            }

            pin_state = HAL_GPIO_ReadPin(GPIOC, GPIO_PIN_13);

            // --- EDGE TRIGGER BUTTON LOGIC ---
            if (pin_state == 0 && last_pin_state == 1) {
                display_mode = !display_mode;
                OLED_Clear();
                dynamic_refresh_needed = 1; // Alert system to redraw static background elements once
                last_toggle_time = 0;       // Force immediate update cycle
                HAL_Delay(50);              // Simple button debounce check
            }
            last_pin_state = pin_state;

            // Everything inside here executes exactly once every 200ms
            if (current_time - last_toggle_time >= 200)
            {
                if (pin_state == 1) {
                    HAL_GPIO_TogglePin(GPIOA, GPIO_PIN_5);
                }

                if (dev_id == 0xE5) {
                    // Keep reading sensor data dynamically regardless of display view state
                    HAL_I2C_Mem_Read(&hi2c1, 0xA6, 0x32, I2C_MEMADD_SIZE_8BIT, raw_data, 6, 100);

                    int16_t raw_x = (int16_t)((raw_data[1] << 8) | raw_data[0]);
                    int16_t raw_y = (int16_t)((raw_data[3] << 8) | raw_data[2]);
                    int16_t raw_z = (int16_t)((raw_data[5] << 8) | raw_data[4]);

                    x_accel = raw_x - x_offset;
                    y_accel = raw_y - y_offset;
                    z_accel = raw_z - z_offset;

                    // BOP DETECTOR (Trigger Dizzy Emotion based on sudden delta/jerk to ignore gravity)
                    static int16_t prev_x = 0, prev_y = 0;
                    int16_t delta_x = x_accel - prev_x;
                    int16_t delta_y = y_accel - prev_y;
                    
                    if (delta_x > 150 || delta_x < -150 || delta_y > 150 || delta_y < -150) {
                        last_bop_time = HAL_GetTick();
                    }
                    prev_x = x_accel;
                    prev_y = y_accel;

                    x_history[filter_idx] = x_accel;
                    y_history[filter_idx] = y_accel;
                    z_history[filter_idx] = z_accel;
                    filter_idx = (filter_idx + 1) % FILTER_DEPTH;

                    int32_t x_sum = 0, y_sum = 0, z_sum = 0;
                    for (int i = 0; i < FILTER_DEPTH; i++) {
                        x_sum += x_history[i];
                        y_sum += y_history[i];
                        z_sum += z_history[i];
                    }

                    int16_t x_smooth = x_sum / FILTER_DEPTH;
                    int16_t y_smooth = y_sum / FILTER_DEPTH;
                    int16_t z_smooth = z_sum / FILTER_DEPTH;
                    if (face_detected) {
                        printf("[STATUS] Tracking Face at X:%d | Rx:%lu | Air: CO2 %dppm TVOC %dppb | Tilt: %d\r\n", target_face_x, uart_rx_count, sgp30_co2, sgp30_tvoc, x_smooth);
                    } else {
                        printf("[STATUS] Idle | Rx:%lu | Air: CO2 %dppm TVOC %dppb | Tilt: %d\r\n", uart_rx_count, sgp30_co2, sgp30_tvoc, x_smooth);
                    }
                    // --- LIVE STREAM TELEMETRY SPLITTER ---
                    if (display_mode == 0) {
						// MODE 0: Active Telemetry
						if (dynamic_refresh_needed) {
							OLED_PrintText(0, 0, "SYSTEM RUNNING!");
							OLED_PrintText(2, 0, "TILT X:");
							OLED_PrintText(4, 0, "CO2:");
							OLED_PrintText(6, 0, "TVOC:");
							dynamic_refresh_needed = 0;
						}

						char display_buffer[24];
						sprintf(display_buffer, "%d      ", x_smooth);
						OLED_PrintText(2, 48, display_buffer);

						sprintf(display_buffer, "%d ppm   ", sgp30_co2);
						OLED_PrintText(4, 48, display_buffer);

						sprintf(display_buffer, "%d ppb   ", sgp30_tvoc);
						OLED_PrintText(6, 48, display_buffer);
					}
					else {
						// MODE 1: Draw dynamic emotional canvas
						// Animation states
                        static uint32_t last_anim_tick = 0;
                        static int anim_frame = 0;
                        
                        if (current_emotion == EMOTION_SEARCHING) {
                            if (current_time - last_anim_tick > 500) {
                                last_anim_tick = current_time;
                                anim_frame = (anim_frame + 1) % 4;
                                dynamic_refresh_needed = 1;
                            }
                        }

                        if (dynamic_refresh_needed) {
                            if (current_emotion == EMOTION_HAPPY) {
							    OLED_DrawBitmap(OLED_SmileBitmap);
                            } else if (current_emotion == EMOTION_ANGRY) {
                                OLED_DrawBitmap(OLED_AngryBitmap);
                            } else if (current_emotion == EMOTION_SEARCHING) {
                                if (anim_frame == 0) OLED_DrawBitmap(OLED_LookLeftBitmap);
                                else if (anim_frame == 1 || anim_frame == 3) OLED_DrawBitmap(OLED_LookCenterBitmap);
                                else OLED_DrawBitmap(OLED_LookRightBitmap);
                            } else if (current_emotion == EMOTION_DIZZY) {
                                OLED_DrawBitmap(OLED_DizzyBitmap);
                            }
							dynamic_refresh_needed = 0;
						}
					}
                last_toggle_time = current_time;
            }

            if (pin_state == 0) {
                HAL_GPIO_WritePin(GPIOA, GPIO_PIN_5, GPIO_PIN_RESET);
            }
		}
    /* USER CODE END WHILE */

    /* USER CODE BEGIN 3 */
    }
  /* USER CODE END 3 */
}

/**
  * @brief System Clock Configuration
  * @retval None
  */
void SystemClock_Config(void)
{
  RCC_OscInitTypeDef RCC_OscInitStruct = {0};
  RCC_ClkInitTypeDef RCC_ClkInitStruct = {0};

  /** Configure the main internal regulator output voltage
  */
  __HAL_RCC_PWR_CLK_ENABLE();
  __HAL_PWR_VOLTAGESCALING_CONFIG(PWR_REGULATOR_VOLTAGE_SCALE1);

  /** Initializes the RCC Oscillators according to the specified parameters
  * in the RCC_OscInitTypeDef structure.
  */
  RCC_OscInitStruct.OscillatorType = RCC_OSCILLATORTYPE_HSI;
  RCC_OscInitStruct.HSIState = RCC_HSI_ON;
  RCC_OscInitStruct.HSICalibrationValue = RCC_HSICALIBRATION_DEFAULT;
  RCC_OscInitStruct.PLL.PLLState = RCC_PLL_NONE;
  if (HAL_RCC_OscConfig(&RCC_OscInitStruct) != HAL_OK)
  {
    Error_Handler();
  }

  /** Initializes the CPU, AHB and APB buses clocks
  */
  RCC_ClkInitStruct.ClockType = RCC_CLOCKTYPE_HCLK|RCC_CLOCKTYPE_SYSCLK
                              |RCC_CLOCKTYPE_PCLK1|RCC_CLOCKTYPE_PCLK2;
  RCC_ClkInitStruct.SYSCLKSource = RCC_SYSCLKSOURCE_HSI;
  RCC_ClkInitStruct.AHBCLKDivider = RCC_SYSCLK_DIV1;
  RCC_ClkInitStruct.APB1CLKDivider = RCC_HCLK_DIV1;
  RCC_ClkInitStruct.APB2CLKDivider = RCC_HCLK_DIV1;

  if (HAL_RCC_ClockConfig(&RCC_ClkInitStruct, FLASH_LATENCY_0) != HAL_OK)
  {
    Error_Handler();
  }
}

/**
  * @brief I2C1 Initialization Function
  * @param None
  * @retval None
  */
static void MX_I2C1_Init(void)
{

  /* USER CODE BEGIN I2C1_Init 0 */

  /* USER CODE END I2C1_Init 0 */

  /* USER CODE BEGIN I2C1_Init 1 */

  /* USER CODE END I2C1_Init 1 */
  hi2c1.Instance = I2C1;
  hi2c1.Init.ClockSpeed = 100000;
  hi2c1.Init.DutyCycle = I2C_DUTYCYCLE_2;
  hi2c1.Init.OwnAddress1 = 0;
  hi2c1.Init.AddressingMode = I2C_ADDRESSINGMODE_7BIT;
  hi2c1.Init.DualAddressMode = I2C_DUALADDRESS_DISABLE;
  hi2c1.Init.OwnAddress2 = 0;
  hi2c1.Init.GeneralCallMode = I2C_GENERALCALL_DISABLE;
  hi2c1.Init.NoStretchMode = I2C_NOSTRETCH_DISABLE;
  if (HAL_I2C_Init(&hi2c1) != HAL_OK)
  {
    Error_Handler();
  }
  /* USER CODE BEGIN I2C1_Init 2 */

  /* USER CODE END I2C1_Init 2 */

}

/**
  * @brief TIM3 Initialization Function
  * @param None
  * @retval None
  */
static void MX_TIM3_Init(void)
{

  /* USER CODE BEGIN TIM3_Init 0 */

  /* USER CODE END TIM3_Init 0 */

  TIM_ClockConfigTypeDef sClockSourceConfig = {0};
  TIM_MasterConfigTypeDef sMasterConfig = {0};
  TIM_OC_InitTypeDef sConfigOC = {0};

  /* USER CODE BEGIN TIM3_Init 1 */

  /* USER CODE END TIM3_Init 1 */
  htim3.Instance = TIM3;
  htim3.Init.Prescaler = 0;
  htim3.Init.CounterMode = TIM_COUNTERMODE_UP;
  htim3.Init.Period = 65535;
  htim3.Init.ClockDivision = TIM_CLOCKDIVISION_DIV1;
  htim3.Init.AutoReloadPreload = TIM_AUTORELOAD_PRELOAD_DISABLE;
  if (HAL_TIM_Base_Init(&htim3) != HAL_OK)
  {
    Error_Handler();
  }
  sClockSourceConfig.ClockSource = TIM_CLOCKSOURCE_INTERNAL;
  if (HAL_TIM_ConfigClockSource(&htim3, &sClockSourceConfig) != HAL_OK)
  {
    Error_Handler();
  }
  if (HAL_TIM_PWM_Init(&htim3) != HAL_OK)
  {
    Error_Handler();
  }
  sMasterConfig.MasterOutputTrigger = TIM_TRGO_RESET;
  sMasterConfig.MasterSlaveMode = TIM_MASTERSLAVEMODE_DISABLE;
  if (HAL_TIMEx_MasterConfigSynchronization(&htim3, &sMasterConfig) != HAL_OK)
  {
    Error_Handler();
  }
  sConfigOC.OCMode = TIM_OCMODE_PWM1;
  sConfigOC.Pulse = 0;
  sConfigOC.OCPolarity = TIM_OCPOLARITY_HIGH;
  sConfigOC.OCFastMode = TIM_OCFAST_DISABLE;
  if (HAL_TIM_PWM_ConfigChannel(&htim3, &sConfigOC, TIM_CHANNEL_1) != HAL_OK)
  {
    Error_Handler();
  }
  if (HAL_TIM_PWM_ConfigChannel(&htim3, &sConfigOC, TIM_CHANNEL_2) != HAL_OK)
  {
    Error_Handler();
  }
  /* USER CODE BEGIN TIM3_Init 2 */

  /* USER CODE END TIM3_Init 2 */
  HAL_TIM_MspPostInit(&htim3);

}

/**
  * @brief USART1 Initialization Function
  * @param None
  * @retval None
  */
static void MX_USART1_UART_Init(void)
{

  /* USER CODE BEGIN USART1_Init 0 */

  /* USER CODE END USART1_Init 0 */

  /* USER CODE BEGIN USART1_Init 1 */

  /* USER CODE END USART1_Init 1 */
  huart1.Instance = USART1;
  huart1.Init.BaudRate = 115200;
  huart1.Init.WordLength = UART_WORDLENGTH_8B;
  huart1.Init.StopBits = UART_STOPBITS_1;
  huart1.Init.Parity = UART_PARITY_NONE;
  huart1.Init.Mode = UART_MODE_TX_RX;
  huart1.Init.HwFlowCtl = UART_HWCONTROL_NONE;
  huart1.Init.OverSampling = UART_OVERSAMPLING_16;
  if (HAL_UART_Init(&huart1) != HAL_OK)
  {
    Error_Handler();
  }
  /* USER CODE BEGIN USART1_Init 2 */

  /* USER CODE END USART1_Init 2 */

}

/**
  * @brief USART2 Initialization Function
  * @param None
  * @retval None
  */
static void MX_USART2_UART_Init(void)
{

  /* USER CODE BEGIN USART2_Init 0 */

  /* USER CODE END USART2_Init 0 */

  /* USER CODE BEGIN USART2_Init 1 */

  /* USER CODE END USART2_Init 1 */
  huart2.Instance = USART2;
  huart2.Init.BaudRate = 115200;
  huart2.Init.WordLength = UART_WORDLENGTH_8B;
  huart2.Init.StopBits = UART_STOPBITS_1;
  huart2.Init.Parity = UART_PARITY_NONE;
  huart2.Init.Mode = UART_MODE_TX_RX;
  huart2.Init.HwFlowCtl = UART_HWCONTROL_NONE;
  huart2.Init.OverSampling = UART_OVERSAMPLING_16;
  if (HAL_UART_Init(&huart2) != HAL_OK)
  {
    Error_Handler();
  }
  /* USER CODE BEGIN USART2_Init 2 */

  /* USER CODE END USART2_Init 2 */

}

/**
  * @brief GPIO Initialization Function
  * @param None
  * @retval None
  */
static void MX_GPIO_Init(void)
{
  GPIO_InitTypeDef GPIO_InitStruct = {0};
/* USER CODE BEGIN MX_GPIO_Init_1 */
/* USER CODE END MX_GPIO_Init_1 */

  /* GPIO Ports Clock Enable */
  __HAL_RCC_GPIOC_CLK_ENABLE();
  __HAL_RCC_GPIOA_CLK_ENABLE();
  __HAL_RCC_GPIOB_CLK_ENABLE();

  /*Configure GPIO pin Output Level */
  HAL_GPIO_WritePin(GPIOA, GPIO_PIN_5|GPIO_PIN_8, GPIO_PIN_RESET);

  /*Configure GPIO pin Output Level */
  HAL_GPIO_WritePin(GPIOB, GPIO_PIN_1|GPIO_PIN_13|GPIO_PIN_14|GPIO_PIN_15, GPIO_PIN_RESET);

  /*Configure GPIO pin Output Level */
  HAL_GPIO_WritePin(GPIOC, GPIO_PIN_8, GPIO_PIN_RESET);

  /*Configure GPIO pins : PC13 PC7 */
  GPIO_InitStruct.Pin = GPIO_PIN_13|GPIO_PIN_7;
  GPIO_InitStruct.Mode = GPIO_MODE_INPUT;
  GPIO_InitStruct.Pull = GPIO_NOPULL;
  HAL_GPIO_Init(GPIOC, &GPIO_InitStruct);

  /*Configure GPIO pins : PA5 PA8 */
  GPIO_InitStruct.Pin = GPIO_PIN_5|GPIO_PIN_8;
  GPIO_InitStruct.Mode = GPIO_MODE_OUTPUT_PP;
  GPIO_InitStruct.Pull = GPIO_NOPULL;
  GPIO_InitStruct.Speed = GPIO_SPEED_FREQ_LOW;
  HAL_GPIO_Init(GPIOA, &GPIO_InitStruct);

  /*Configure GPIO pins : PB1 PB13 PB14 PB15 */
  GPIO_InitStruct.Pin = GPIO_PIN_1|GPIO_PIN_13|GPIO_PIN_14|GPIO_PIN_15;
  GPIO_InitStruct.Mode = GPIO_MODE_OUTPUT_PP;
  GPIO_InitStruct.Pull = GPIO_NOPULL;
  GPIO_InitStruct.Speed = GPIO_SPEED_FREQ_LOW;
  HAL_GPIO_Init(GPIOB, &GPIO_InitStruct);

  /*Configure GPIO pin : PC8 */
  GPIO_InitStruct.Pin = GPIO_PIN_8;
  GPIO_InitStruct.Mode = GPIO_MODE_OUTPUT_PP;
  GPIO_InitStruct.Pull = GPIO_NOPULL;
  GPIO_InitStruct.Speed = GPIO_SPEED_FREQ_LOW;
  HAL_GPIO_Init(GPIOC, &GPIO_InitStruct);

/* USER CODE BEGIN MX_GPIO_Init_2 */
/* USER CODE END MX_GPIO_Init_2 */
}

/* USER CODE BEGIN 4 */
void HAL_UART_RxCpltCallback(UART_HandleTypeDef *huart) {
    if (huart->Instance == USART1) {
        uart_rx_count++;
        if (uart1_rx_byte == '\n') {
            esp32_rx_buffer[esp32_rx_index] = '\0';
            int id, x, y;
            if (sscanf(esp32_rx_buffer, "FACE:%d,%d,%d", &id, &x, &y) == 3) {
                if (id >= -1) {
                    face_detected = 1;
                    target_face_x = x;
                    target_face_y = y;
                    last_face_time = HAL_GetTick();
                } else if (id == -2) {
                    face_detected = 0;
                }
            }
            esp32_rx_index = 0;
        } else {
            if (esp32_rx_index < 63) {
                esp32_rx_buffer[esp32_rx_index++] = uart1_rx_byte;
            }
        }
        HAL_UART_Receive_IT(&huart1, &uart1_rx_byte, 1);
    }
}

void HAL_UART_ErrorCallback(UART_HandleTypeDef *huart) {
    if (huart->Instance == USART1) {
        // Clear Overrun Error flag and re-arm interrupt
        __HAL_UART_CLEAR_OREFLAG(huart);
        HAL_UART_Receive_IT(&huart1, &uart1_rx_byte, 1);
    }
}

#ifdef __GNUC__
#define PUTCHAR_PROTOTYPE int __io_putchar(int ch)
#else
#define PUTCHAR_PROTOTYPE int fputc(int ch, FILE *f)
#endif
PUTCHAR_PROTOTYPE {
  HAL_UART_Transmit(&huart2, (uint8_t *)&ch, 1, 10);
  return ch;
}
/* USER CODE END 4 */

/**
  * @brief  This function is executed in case of error occurrence.
  * @retval None
  */
void Error_Handler(void)
{
  /* USER CODE BEGIN Error_Handler_Debug */
  /* User can add his own implementation to report the HAL error return state */
  __disable_irq();
  while (1)
  {
  }
  /* USER CODE END Error_Handler_Debug */
}

#ifdef  USE_FULL_ASSERT
/**
  * @brief  Reports the name of the source file and the source line number
  *         where the assert_param error has occurred.
  * @param  file: pointer to the source file name
  * @param  line: assert_param error line source number
  * @retval None
  */
void assert_failed(uint8_t *file, uint32_t line)
{
  /* USER CODE BEGIN 6 */
  /* User can add his own implementation to report the file name and line number,
     ex: printf("Wrong parameters value: file %s on line %d\r\n", file, line) */
  /* USER CODE END 6 */
}
#endif /* USE_FULL_ASSERT */
